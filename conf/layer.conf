## conf/layer.conf
```bitbake
# We have a conf and classes directory, append to BBPATH
BBPATH .= ":${LAYERDIR}"

# We have recipes-* directories, add to BBFILES
BBFILES += "${LAYERDIR}/recipes-*/*/*.bb ${LAYERDIR}/recipes-*/*/*.bbappend"
# Recipes which backport later versions of other layers are placed here.
# Only valid for Toradex distributions.
BACKPORT_BBFILES = "${LAYERDIR}/backports/recipes-*/*/*.bb ${LAYERDIR}/backports/recipes-*/*/*.bbappend"
BBFILES += "${@ d.getVar('BACKPORT_BBFILES') if 'tdx' in d.getVar('DISTROOVERRIDES').split(':') else ''}"

BBFILE_COLLECTIONS += "toradex-nxp-layer"
BBFILE_PATTERN_toradex-nxp-layer = "^${LAYERDIR}/"
BBFILE_PRIORITY_toradex-nxp-layer = "22"

# Let us add layer-specific bbappends which are only applied when that
# layer is included in our configuration
BBFILES += "${@' '.join('${LAYERDIR}/%s/recipes*/*/*.bbappend' % layer \
               for layer in BBFILE_COLLECTIONS.split())}"
# Add layer-specific bb files too
BBFILES += "${@' '.join('${LAYERDIR}/%s/recipes*/*/*.bb' % layer \
               for layer in BBFILE_COLLECTIONS.split())}"

LAYERDEPENDS_toradex-nxp-layer = " \
    core \
    freescale-layer \
    freescale-3rdparty \
    toradex-bsp-common-layer \
"
LAYERSERIES_COMPAT_toradex-nxp-layer = "zeus dunfell"

FSL_EULA_FILE_MD5SUM_LA_OPT_NXP_SOFTWARE_LICENSE_V13 = "1b4db4b25c3a1e422c0c0ed64feb65d2"
FSL_EULA_FILE_MD5SUM_LA_OPT_NXP_SOFTWARE_LICENSE_V15 = "983e4c77621568488dd902b27e0c2143"
FSL_EULA_FILE_MD5SUM_LA_OPT_NXP_SOFTWARE_LICENSE_V16 = "e9e880185bda059c90c541d40ceca922"
FSL_EULA_FILE_MD5SUM_LA_OPT_NXP_SOFTWARE_LICENSE_V17 = "cf3f9b8d09bc3926b1004ea71f7a248a"
FSL_EULA_FILE_MD5SUM_LA_OPT_NXP_SOFTWARE_LICENSE_V18 = "231e11849a4331fcbb19d7f4aab4a659"
FSL_EULA_FILE_MD5SUM_LA_OPT_NXP_SOFTWARE_LICENSE_V19 = "a632fefd1c359980434f9389833cab3a"
FSL_EULA_FILE_MD5SUM_LA_OPT_NXP_SOFTWARE_LICENSE_V22 = "3c3fe2b904fd694f28d2f646ee16dddb"
FSL_EULA_FILE_MD5SUM_LA_OPT_NXP_SOFTWARE_LICENSE_V23 = "85d06b38f17b935ca11784d67075b846"
FSL_EULA_FILE_MD5SUM_LA_OPT_NXP_SOFTWARE_LICENSE_V24 = "417b82f17fc02b88125331ed312f6f1b"
FSL_EULA_FILE_MD5SUM_LA_OPT_NXP_SOFTWARE_LICENSE_V24.1 = "b3b0bab6ff55420d043cf1652c52d788"
FSL_EULA_FILE_MD5SUM_LA_OPT_NXP_SOFTWARE_LICENSE_V25 = "f35df765ff17e69043ea21f350e3229c"
FSL_EULA_FILE_MD5SUM_LA_OPT_NXP_SOFTWARE_LICENSE_V27 = "e565271ec9a80ce47abbddc4bffe56fa"
FSL_EULA_FILE_MD5SUM_LA_OPT_NXP_SOFTWARE_LICENSE_V30 = "03bcadc8dc0a788f66ca9e2b89f56c6f"
FSL_EULA_FILE_MD5SUM_LA_OPT_NXP_SOFTWARE_LICENSE_V31 = "dedee5689786754f61ea3a76035c8a81"
FSL_EULA_FILE_MD5SUM_LA_OPT_NXP_SOFTWARE_LICENSE_V32 = "17d2319de7baa686e8a755ba58a9ebf5"
FSL_EULA_FILE_MD5SUM_LA_OPT_NXP_SOFTWARE_LICENSE_V33 = "e4098ac4459cb81b07d3f0c22b3e8370"
FSL_EULA_FILE_MD5SUM_LA_OPT_NXP_SOFTWARE_LICENSE_V34 = "be5ff43682ed6c57dfcbeb97651c2829"
FSL_EULA_FILE_MD5SUMS_append = " \
    ${FSL_EULA_FILE_MD5SUM_LA_OPT_NXP_SOFTWARE_LICENSE_V13} \
    ${FSL_EULA_FILE_MD5SUM_LA_OPT_NXP_SOFTWARE_LICENSE_V15} \
    ${FSL_EULA_FILE_MD5SUM_LA_OPT_NXP_SOFTWARE_LICENSE_V16} \
    ${FSL_EULA_FILE_MD5SUM_LA_OPT_NXP_SOFTWARE_LICENSE_V17} \
    ${FSL_EULA_FILE_MD5SUM_LA_OPT_NXP_SOFTWARE_LICENSE_V18} \
    ${FSL_EULA_FILE_MD5SUM_LA_OPT_NXP_SOFTWARE_LICENSE_V19} \
    ${FSL_EULA_FILE_MD5SUM_LA_OPT_NXP_SOFTWARE_LICENSE_V22} \
    ${FSL_EULA_FILE_MD5SUM_LA_OPT_NXP_SOFTWARE_LICENSE_V23} \
    ${FSL_EULA_FILE_MD5SUM_LA_OPT_NXP_SOFTWARE_LICENSE_V24} \
    ${FSL_EULA_FILE_MD5SUM_LA_OPT_NXP_SOFTWARE_LICENSE_V24.1} \
    ${FSL_EULA_FILE_MD5SUM_LA_OPT_NXP_SOFTWARE_LICENSE_V25} \
    ${FSL_EULA_FILE_MD5SUM_LA_OPT_NXP_SOFTWARE_LICENSE_V27} \
    ${FSL_EULA_FILE_MD5SUM_LA_OPT_NXP_SOFTWARE_LICENSE_V30} \
    ${FSL_EULA_FILE_MD5SUM_LA_OPT_NXP_SOFTWARE_LICENSE_V31} \
    ${FSL_EULA_FILE_MD5SUM_LA_OPT_NXP_SOFTWARE_LICENSE_V32} \
    ${FSL_EULA_FILE_MD5SUM_LA_OPT_NXP_SOFTWARE_LICENSE_V33} \
    ${FSL_EULA_FILE_MD5SUM_LA_OPT_NXP_SOFTWARE_LICENSE_V34} \
"
```

## conf/machine/apalis-imx6-mainline.conf
```bitbake
MACHINEOVERRIDES .= ":apalis-imx6:use-mainline-bsp"
require conf/machine/apalis-imx6.conf
include conf/machine/include/apalis-imx6.inc
MACHINE_NAME = "Apalis-iMX6-Mainline"
UBOOT_SUFFIX_use-mainline-bsp = "img"
```

## conf/machine/apalis-imx6.conf
```bitbake
#@TYPE: Machine
#@NAME: Toradex Apalis iMX6Q/D
#@SOC: i.MX6
#@DESCRIPTION: Machine configuration for Toradex Apalis iMX6 SOM
#@MAINTAINER: Max Krummenacher <max.krummenacher@toradex.com>

MACHINEOVERRIDES =. "mx6:mx6q:"

include conf/machine/include/imx-base.inc
include conf/machine/include/tune-cortexa9.inc

PREFERRED_PROVIDER_virtual/kernel ?= "linux-toradex"
KERNEL_DEVICETREE += "imx6q-apalis-eval.dtb imx6q-apalis_v1_0-eval.dtb \
                     imx6q-apalis-ixora.dtb imx6q-apalis_v1_0-ixora.dtb \
                     imx6q-apalis-ixora-v1.1.dtb"
KERNEL_IMAGETYPE = "uImage"
# The kernel lives in a seperate FAT partition, don't deploy it in /boot/
RDEPENDS_kernel-base = ""

PREFERRED_PROVIDER_u-boot ?= "u-boot-toradex"
PREFERRED_PROVIDER_virtual/bootloader ?= "u-boot-toradex"
SPL_BINARY = "SPL"
# The SPL configures the DDR RAM depending on the module it runs on. Thus there
# is no need to distingush between the different module types.
# For recovery mode we build a U-Boot with save timings for all known Apalis iMX6
# Note: The last config will be symlinked to UBOOT_BINARY which is crucial for
# certain image formats.
UBOOT_CONFIG ??= "recover spl"
UBOOT_CONFIG[spl] = "apalis_imx6_defconfig,,u-boot.img"
UBOOT_CONFIG[recover] = "apalis_imx6_nospl_it_defconfig,,u-boot.imx"
UBOOT_MAKE_TARGET = ""
# The payload offsets are given in number of 512 byte blocks.
OFFSET_BOOTROM_PAYLOAD = "2"
OFFSET_SPL_PAYLOAD = "138"

IMAGE_CLASSES += "image_type_tezi"
IMAGE_FSTYPES = "tar.xz teziimg"

SERIAL_CONSOLE ?= "115200 ttymxc0"
TORADEX_PRODUCT_IDS_apalis-imx6 = "0027 0028 0029 0035"

MACHINE_FEATURES += "screen usbgadget usbhost vfat ext2 alsa touchscreen wifi bluetooth 3g pci"
```

## conf/machine/apalis-imx8.conf
```bitbake
#@TYPE: Machine
#@NAME: Toradex Apalis iMX8
#@DESCRIPTION: Toradex Apalis iMX8 powered by a i.MX 8QuadMax SoC
#@MAINTAINER: Stefan Agner <stefan.agner@toradex.com>

MACHINE_NAME = "Apalis-iMX8"

SOC_SILICON_REV ?= ""

MACHINEOVERRIDES =. "mx8:mx8qm:"

IMX_DEFAULT_BSP = "nxp"

require conf/machine/include/imx-base.inc
# override imx-base.inc which sets this to cortexa72-cortexa53-crypto
DEFAULTTUNE_mx8qm = "aarch64"
require conf/machine/include/tune-cortexa72-cortexa53.inc

# Don't include kernels in standard images
RDEPENDS_${KERNEL_PACKAGE_NAME}-base = ""

LOADADDR = ""

# we do not want to have getty running on tty1 as we run
# auto-serial-console there
USE_VT = "0"

KERNEL_DEVICETREE = " \
    freescale/imx8qm-apalis-eval.dtb \
    freescale/imx8qm-apalis-eval-ar0521.dtb \
    freescale/imx8qm-apalis-ixora-v1.1.dtb \
    freescale/imx8qm-apalis-ixora-v1.1-ar0521.dtb \
    freescale/imx8qm-apalis-v1.1-eval.dtb \
    freescale/imx8qm-apalis-v1.1-eval-ar0521.dtb \
"

UBOOT_SUFFIX = "bin"
UBOOT_CONFIG ??= "sd"
UBOOT_CONFIG[sd] = "apalis-imx8_defconfig,sdcard"

UBOOT_ENTRYPOINT = "0x80280000"
UBOOT_RD_LOADADDRESS = "0xA0000000"

BOOT_SPACE = "65536"
IMAGE_BOOTLOADER = "imx-boot"
IMX_BOOT_SEEK = "32"

IMAGE_BOOT_FILES_append = " boot.scr-${MACHINE};boot.scr hdmitxfw.bin dpfw.bin"
WKS_FILE_DEPENDS_append = " u-boot-default-script"
PREFERRED_PROVIDER_u-boot-default-script = "u-boot-distro-boot"

PREFERRED_PROVIDER_virtual/kernel = "linux-toradex"
PREFERRED_PROVIDER_virtual/kernel_preempt-rt = "linux-toradex"
PREFERRED_PROVIDER_virtual/bootloader = "u-boot-toradex"
# Currently we use the nxp 2020.04 downstream for mx8 as some features are
# not yet available in 2020.07.
PREFERRED_VERSION_u-boot-toradex = "2020.04"

MACHINE_FIRMWARE_append = " linux-firmware-pcie8997"
MACHINE_FIRMWARE_append = " firmware-imx-vpu-imx8"

IMXBOOT_TARGETS = "flash_b0"

BOARD_TYPE = "apalis"

IMAGE_CLASSES_append = " image_type_tezi"
IMAGE_FSTYPES += "teziimg"

# The imx-boot container takes care for the i.MX 8 offset, so the container
# has to be flashed at offset 0 directly
UBOOT_BINARY_TEZI_EMMC = "imx-boot"
OFFSET_BOOTROM_PAYLOAD = "0"

TORADEX_PRODUCT_IDS = "0037 0047 0048 0049"
TORADEX_PRODUCT_IDS[0037] = "imx8qm-apalis-v1.1-eval.dtb"
TORADEX_PRODUCT_IDS[0047] = "imx8qm-apalis-v1.1-eval.dtb"
TORADEX_PRODUCT_IDS[0048] = "imx8qm-apalis-v1.1-eval.dtb"
TORADEX_PRODUCT_IDS[0049] = "imx8qm-apalis-v1.1-eval.dtb"
```

## conf/machine/apalis-imx8a0.conf
```bitbake
SOC_SILICON_REV = "a0"

MACHINEOVERRIDES .= ":apalis-imx8"
require conf/machine/apalis-imx8.conf
MACHINE_NAME = "Apalis-iMX8-A0"
```

## conf/machine/apalis-imx8x-v11a.conf
```bitbake
#@TYPE: Machine
#@NAME: Toradex Apalis iMX8X with B0 silicon
#@DESCRIPTION: Toradex Apalis iMX8X powered by a i.MX 8X SoC (B0 silicon) as found on all V1.0 and V1.1A versions
#@MAINTAINER: Philippe Schenker <philippe.schenker@toradex.com>

# Set SoC revision to B0
MACHINE_FEATURES_append = " soc-revb0"

# keep the original machine as an override with high prio
MACHINEOVERRIDES =. "apalis-imx8x:"

require conf/machine/apalis-imx8x.conf

# reuse DISTRO_FLAVOUR to display special version exception in the
# Toradex Easy Installer application
DISTRO_FLAVOUR_append = " for V1.1A HW"
MACHINE_NAME = "Apalis-iMX8X-V11A"
```

## conf/machine/aquila-imx95.conf
```bitbake
#@TYPE: Machine
#@NAME: Toradex Aquila iMX95
#@SOC: i.MX 95
#@DESCRIPTION: Machine configuration for Toradex Aquila i.MX95
#@MAINTAINER: Max Krummenacher <max.krummenacher@toradex.com>

MACHINE_NAME = "Aquila-iMX95"

MACHINEOVERRIDES =. "tdx:mx95:"

require conf/machine/include/imx-base.inc
require conf/machine/include/arm/armv8-2a/tune-cortexa55.inc

MACHINE_EXTRA_RRECOMMENDS:append = " linux-firmware-ath12k-wcn7850 linux-firmware-qca"

MACHINE_FEATURES += "pci wifi bluetooth optee tpm2"

IMX_DEFAULT_BSP = "nxp"

PREFERRED_PROVIDER_virtual/kernel = "linux-toradex-imx"
KERNEL_IMAGETYPE:mx95-generic-bsp = "Image.gz"

KERNEL_DTB_PREFIX = "freescale/"
KERNEL_DEVICETREE:append:use-nxp-bsp = " \
    ${KERNEL_DTB_PREFIX}imx95-aquila-dev.dtb \
"

IMX_DEFAULT_BOOTLOADER = "u-boot-toradex-imx"
UBOOT_SUFFIX = "bin"
SPL_BINARY = "spl/u-boot-spl.bin"
UBOOT_MAKE_TARGET = ""
UBOOT_CONFIG_BASENAME = "aquila-imx95"

UBOOT_CONFIG ??= "sd"
UBOOT_CONFIG[sd] = "${UBOOT_CONFIG_BASENAME}_defconfig"

UBOOT_DTB_LOADADDRESS:mx95-generic-bsp = "0x9c400000"
UBOOT_DTBO_LOADADDRESS:mx95-generic-bsp = "0x9c440000"
UBOOT_ENTRYPOINT:mx95-generic-bsp = "0x94400000"
UBOOT_RD_LOADADDRESS = "0x9e800000"

IMXBOOT_TARGETS = "flash_a55"
IMX_BOOT_SOC_TARGET = "iMX95"
IMX_BOOT_SEEK = "32"

IMAGE_BOOT_FILES:append = " boot.scr-${MACHINE};boot.scr"
WKS_FILE_DEPENDS:append = " u-boot-default-script"
PREFERRED_PROVIDER_u-boot-default-script = "u-boot-distro-boot"

ATF_PLATFORM = "imx95"
ATF_SYS_PWR_FULL_CTRL = "1"

PREFERRED_PROVIDER_virtual/imx-oei = "imx-oei-toradex"
OEI_CONFIGS = "ddr"
OEI_CORE   = "m33"
OEI_SOC    = "mx95"
OEI_BOARD  ?= "toradex-aquila-imx95"
DDR_TYPE   ?= "lpddr5"

LPDDR_FW_VERSION = "_v202409"
DDR_FIRMWARE_NAME = " \
    lpddr5_dmem${LPDDR_FW_VERSION}.bin \
    lpddr5_dmem_qb${LPDDR_FW_VERSION}.bin \
    lpddr5_imem${LPDDR_FW_VERSION}.bin \
    lpddr5_imem_qb${LPDDR_FW_VERSION}.bin \
"

IMXBOOT_VARIANT = ""

PREFERRED_PROVIDER_virtual/imx-system-manager = "imx-sm-toradex"
SYSTEM_MANAGER_CONFIG = "aquila-imx95"
# The System Manager Firmware Name corresponds to a particular binary implementation
# in the Yocto deploy folder. The name is comprised of the Firmware Basename and the
# default system manager Config name, e.g., m33_image-mx95evk.bin and
# m33_image-mx95evk_fusa.bin for the standard BSP version and FuSa version, respectively
# The System Manager Firmware Basename is an alias used by imx-boot instead of using
# a unique name for each implementation, e.g., m33_image.bin for i.MX 95
SYSTEM_MANAGER_FIRMWARE_BASENAME ?= "m33_image"
SYSTEM_MANAGER_FIRMWARE_NAME ?= "m33_image-aquila-imx95"

# We have to disable SERIAL_CONSOLE due to auto-serial-console
SERIAL_CONSOLES = "115200;ttyLP2"

IMAGE_CLASSES:append = " image_type_tezi"
IMAGE_FSTYPES += "teziimg"

# The imx-boot container takes care for the i.MX 9 offset, so the container
# has to be flashed at offset 0 directly
UBOOT_BINARY_TEZI_EMMC = "imx-boot"
OFFSET_BOOTROM_PAYLOAD = "0"

TEZI_EXTERNAL_KERNEL_DEVICETREE_BOOT = " \
    aquila-imx95_spi1_spidev_overlay.dtbo \
    aquila-imx95_spi2_spidev_overlay.dtbo \
"

TORADEX_PRODUCT_IDS = "0098"
```

## conf/machine/colibri-imx6-mainline.conf
```bitbake
MACHINEOVERRIDES .= ":colibri-imx6:use-mainline-bsp"
require conf/machine/colibri-imx6.conf
require conf/machine/include/colibri-imx6.inc
MACHINE_NAME = "Colibri-iMX6-Mainline"
UBOOT_SUFFIX_use-mainline-bsp = "img"
#override the setting in meta-freescale-3rdparty
PREFERRED_PROVIDER_virtual/kernel_use-mainline-bsp = "linux-toradex-mainline"
```

## conf/machine/colibri-imx6ull.conf
```bitbake
#@TYPE: Machine
#@NAME: Toradex Colibri iMX6ULL
#@SOC: i.MX6ULL
#@DESCRIPTION: Machine configuration for Toradex Colibri iMX6 ULL SOM
#@MAINTAINER: Max Krummenacher <max.krummenacher@toradex.com>

MACHINEOVERRIDES =. "mx6:mx6ul:mx6ull:"

include conf/machine/include/imx-base.inc
include conf/machine/include/tune-cortexa7.inc

PREFERRED_PROVIDER_virtual/kernel ?= "linux-toradex"
PREFERRED_PROVIDER_virtual/kernel_use-mainline-bsp ??= "linux-toradex-mainline"
KERNEL_DEVICETREE += " \
    imx6ull-colibri-eval-v3.dtb imx6ull-colibri-wifi-eval-v3.dtb \
    imx6ull-colibri-aster.dtb imx6ull-colibri-wifi-aster.dtb \
"
KERNEL_DEVICETREE_use-mainline-bsp = "imx6ull-colibri-eval-v3.dtb imx6ull-colibri-wifi-eval-v3.dtb"
KERNEL_IMAGETYPE = "zImage"
# The kernel lives in its own ubi volume.
RDEPENDS_${KERNEL_PACKAGE_NAME}-base = ""

PREFERRED_PROVIDER_u-boot ?= "u-boot-toradex"
PREFERRED_PROVIDER_virtual/bootloader ?= "u-boot-toradex"
PREFERRED_PROVIDER_u-boot-fw-utils ?= "u-boot-toradex-fw-utils"
UBOOT_BINARY = "u-boot-nand.imx"
UBOOT_MAKE_TARGET = "u-boot.imx"
UBOOT_MACHINE ?= "colibri-imx6ull_defconfig"

IMAGE_FSTYPES += "wic.gz tar.xz"
# wic support
WKS_FILE = "sdimage-bootpart.wks"
WIC_CREATE_EXTRA_ARGS_append = " --no-fstab-update"

SERIAL_CONSOLES = "115200;ttymxc0"

MACHINE_FEATURES += "screen usbgadget usbhost vfat ext2 alsa touchscreen wifi bluetooth 3g"
MACHINE_FIRMWARE_remove = "firmware-imx-epdc"
```

## conf/machine/colibri-imx7-emmc.conf
```bitbake
#@TYPE: Machine
#@NAME: Toradex Colibri iMX7 Dual 1GB (eMMC)
#@SOC: i.MX 7Dual
#@DESCRIPTION: Machine configuration for Toradex Colibri iMX7 SOM
#@MAINTAINER: Stefan Agner <stefan.agner@toradex.com>

MACHINEOVERRIDES =. "mx7:mx7d:"

include conf/machine/include/imx-base.inc
include conf/machine/include/tune-cortexa7.inc

PREFERRED_PROVIDER_virtual/kernel ?= "linux-toradex"
KERNEL_IMAGETYPE = "zImage"
KERNEL_DEVICETREE += "imx7d-colibri-emmc-eval-v3.dtb imx7d-colibri-emmc-aster.dtb"

# The kernel lives in a seperate FAT partition, don't deploy it in /boot/
RDEPENDS_kernel-base = ""

PREFERRED_PROVIDER_u-boot ?= "u-boot-toradex"
PREFERRED_PROVIDER_virtual/bootloader ?= "u-boot-toradex"
UBOOT_MACHINE ?= "colibri_imx7_emmc_defconfig"

IMAGE_FSTYPES = "wic.gz tar.xz"
# wic support
WKS_FILE = "sdimage-bootpart.wks"
WIC_CREATE_EXTRA_ARGS_append = " --no-fstab-update"

SERIAL_CONSOLE = "115200 ttymxc0"

MACHINE_FEATURES += "screen usbgadget usbhost vfat ext2 alsa touchscreen wifi bluetooth 3g"
```
