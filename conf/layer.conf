## conf/machine/colibri-imx7.conf
```bitbake
#@TYPE: Machine
#@NAME: Toradex Colibri iMX7D
#@SOC: i.MX7D
#@DESCRIPTION: Machine configuration for Toradex Colibri iMX7 SOM
#@MAINTAINER: Max Krummenacher <max.krummenacher@toradex.com>

include conf/machine/include/imx-base.inc
include conf/machine/include/tune-cortexa7.inc

SOC_FAMILY = "mx7"

PREFERRED_PROVIDER_virtual/kernel ?= "linux-toradex"
KERNEL_IMAGETYPE = "zImage"
KERNEL_DEVICETREE += "imx7d-colibri.dtb imx7s-colibri.dtb"

# U-Boot of our newer release read the Kernel and device tree from static UBI
# volumes, hence no need to deploy the kernel binary in the image itself
RDEPENDS_kernel-base = ""

PREFERRED_PROVIDER_u-boot = "u-boot-toradex"
PREFERRED_PROVIDER_virtual/bootloader = "u-boot-toradex"
# U-Boot NAND binary includes 0x400 padding required for NAND boot
UBOOT_BINARY = "u-boot-nand.imx"
UBOOT_MAKE_TARGET = "u-boot-nand.imx"
UBOOT_MACHINE = "colibri_imx7_defconfig"

IMAGE_FSTYPES = "tar.bz2 sdcard"

SERIAL_CONSOLE = "115200 ttymxc0"

MACHINE_FEATURES += "screen usbgadget usbhost vfat ext2 alsa touchscreen wifi bluetooth 3g"
```

## conf/machine/colibri-imx8qxp.conf
```bitbake
#@TYPE: Machine
#@NAME: Colibri iMX8QXP
#@DESCRIPTION: Colibri iMX8QXP powered by a i.MX 8QXP SoC
#@MAINTAINER: Max Krummenacher <max.krummenacherr@toradex.com>

MACHINEOVERRIDES =. "mx8:mx8x:mx8qxp:"

require conf/machine/include/imx-base.inc
require conf/machine/include/arm/arch-arm64.inc

# Don't include kernels in standard images
RDEPENDS_${KERNEL_PACKAGE_NAME}-base = ""

LOADADDR = ""

# We have to disable SERIAL_CONSOLE due to auto-serial-console
SERIAL_CONSOLES = "115200;ttyAMA1"

# we do not want to have getty running on tty1 as we run
# auto-serial-console there
USE_VT = "0"

KERNEL_DEVICETREE = " \
    freescale/fsl-imx8qxp-colibri-eval-v3.dtb \
    freescale/fsl-imx8qxp-colibri-dsihdmi-eval-v3.dtb \
    freescale/fsl-imx8qxp-colibri-lvds-dual-eval-v3.dtb \
    freescale/fsl-imx8qxp-colibri-lvds-single-eval-v3.dtb \
"

UBOOT_MAKE_TARGET = "u-boot.bin"
UBOOT_SUFFIX = "bin"
UBOOT_CONFIG ??= "sd"
UBOOT_CONFIG[sd] = "colibri-imx8qxp_config,sdcard"

BOOT_SPACE = "65536"
IMAGE_BOOTLOADER = "imx-boot"
IMX_BOOT_SEEK = "32"

PREFERRED_PROVIDER_virtual/kernel = "linux-toradex"
PREFERRED_PROVIDER_virtual/bootloader = "u-boot-toradex"

MACHINE_FIRMWARE_append = " linux-firmware-pcie8997"
MACHINE_FIRMWARE_append = " firmware-imx-vpu-imx8"

IMXBOOT_TARGETS = "${@bb.utils.contains('UBOOT_CONFIG', 'fspi', 'flash_flexspi', \
                                                                'flash_all flash', d)}"

BOARD_TYPE = "colibri"
```

## conf/machine/colibri-imx8x-v10b.conf
```bitbake
#@TYPE: Machine
#@NAME: Toradex Colibri iMX8X with B0 silicon
#@DESCRIPTION: Toradex Colibri iMX8X powered by a i.MX 8X SoC (B0 silicon) as found on older SoM Versions V1.0B
#@MAINTAINER: Max Krummenacher <max.krummenacherr@toradex.com>

# Set SoC revision to B0
MACHINE_FEATURES_append = " soc-revb0"

# keep the original machine as an override with high prio
MACHINEOVERRIDES =. "colibri-imx8x:"

require conf/machine/colibri-imx8x.conf

# reuse DISTRO_FLAVOUR to display special version exception in the
# Toradex Easy Installer application
DISTRO_FLAVOUR_append = " for V1.0B HW"
MACHINE_NAME = "Colibri-iMX8X-V10B"
```

## conf/machine/colibri-imx8x.conf
```bitbake
#@TYPE: Machine
#@NAME: Colibri iMX8X
#@DESCRIPTION: Colibri iMX8X powered by a i.MX 8X SoC
#@MAINTAINER: Max Krummenacher <max.krummenacherr@toradex.com>

MACHINE_NAME = "Colibri-iMX8X"

MACHINEOVERRIDES =. "mx8:mx8x:mx8qxp:"

require conf/machine/include/imx-base.inc
require conf/machine/include/arm/arch-arm64.inc

# Don't include kernels in standard images
RDEPENDS_${KERNEL_PACKAGE_NAME}-base = ""

LOADADDR = ""

# we do not want to have getty running on tty1 as we run
# auto-serial-console there
USE_VT = "0"

KERNEL_DEVICETREE = " \
    freescale/fsl-imx8qxp-colibri-eval-v3.dtb \
    freescale/fsl-imx8qxp-colibri-dsihdmi-eval-v3.dtb \
    freescale/fsl-imx8qxp-colibri-lvds-dual-eval-v3.dtb \
    freescale/fsl-imx8qxp-colibri-lvds-single-eval-v3.dtb \
"

UBOOT_MAKE_TARGET = "u-boot.bin"
UBOOT_SUFFIX = "bin"
UBOOT_CONFIG ??= "sd"
UBOOT_CONFIG[sd] = "colibri-imx8qxp_config,sdcard"

BOOT_SPACE = "65536"
IMAGE_BOOTLOADER = "imx-boot"
IMX_BOOT_SEEK = "32"

MACHINE_BOOT_FILES = "boot.scr"
IMAGE_BOOT_FILES_append = " ${MACHINE_BOOT_FILES}"
WKS_FILE_DEPENDS_append = " u-boot-distro-boot"

PREFERRED_PROVIDER_virtual/kernel = "linux-toradex"
PREFERRED_PROVIDER_virtual/bootloader = "u-boot-toradex"
PREFERRED_PROVIDER_u-boot-fw-utils ?= "u-boot-toradex-fw-utils"
# Currently we use the nxp 2018.03 downstream for mx8 as some features are
# not yet available in 2019.03.
PREFERRED_VERSION_u-boot-toradex = "2018.03"
PREFERRED_VERSION_u-boot-toradex-fw-utils = "2018.03"

MACHINE_FIRMWARE_append = " linux-firmware-pcie8997"
MACHINE_FIRMWARE_append = " firmware-imx-vpu-imx8"

IMXBOOT_TARGETS = "flash"

PREFERRED_PROVIDER_virtual/libg2d_imxdpu = "imx-dpu-g2d"
PREFERRED_VERSION_wayland-protocols_mx8 = "1.16.imx"
PREFERRED_VERSION_weston_mx8 = "5.0.0.imx"

BOARD_TYPE = "colibri"

IMAGE_CLASSES_append = " image_type_tezi"
IMAGE_FSTYPES += "teziimg"

# The imx-boot container takes care for the i.MX 8 offset, so the container
# has to be flashed at offset 0 directly
UBOOT_BINARY_TEZI_EMMC="imx-boot"
OFFSET_BOOTROM_PAYLOAD="0"
do_image_teziimg[depends] += "imx-boot:do_deploy"
do_image_teziimg_distro[depends] += "imx-boot:do_deploy"

TORADEX_PRODUCT_IDS = "0038 0050 0051 0052"
TORADEX_PRODUCT_IDS[0038] = "fsl-imx8qxp-colibri-eval-v3.dtb"
TORADEX_PRODUCT_IDS[0050] = "fsl-imx8qxp-colibri-eval-v3.dtb"
TORADEX_PRODUCT_IDS[0051] = "fsl-imx8qxp-colibri-eval-v3.dtb"
TORADEX_PRODUCT_IDS[0052] = "fsl-imx8qxp-colibri-eval-v3.dtb"
```

## conf/machine/include/apalis-imx6.inc
```bitbake
IMAGE_CLASSES_append = " image_type_tezi"
IMAGE_FSTYPES_append = " teziimg"
TORADEX_PRODUCT_IDS = "0027 0028 0029 0035"
# The payload offsets are given in number of 512 byte blocks.
OFFSET_BOOTROM_PAYLOAD = "2"
OFFSET_SPL_PAYLOAD = "138"

MACHINE_NAME = "Apalis-iMX6"

IMAGE_BOOT_FILES_append = " boot.scr-${MACHINE};boot.scr"
WKS_FILE_DEPENDS_append = " u-boot-distro-boot"

KERNEL_DEVICETREE += "imx6q-apalis-ixora-v1.2.dtb"
KERNEL_DEVICETREE_use-mainline-bsp += " \
    imx6q-apalis-eval.dtb \
    imx6q-apalis-ixora-v1.1.dtb \
"

PREFERRED_PROVIDER_virtual/kernel = "linux-toradex"
PREFERRED_PROVIDER_virtual/kernel_preempt-rt = "linux-toradex"
PREFERRED_PROVIDER_virtual/kernel_use-mainline-bsp = "linux-toradex-mainline"
PREFERRED_PROVIDER_virtual/kernel_use-mainline-bsp_preempt-rt = "linux-toradex-mainline"
PREFERRED_PROVIDER_virtual/dtb_use-mainline-bsp = "device-tree-overlays-mainline"

PREFERRED_PROVIDER_u-boot-default-script = "u-boot-distro-boot"
UBOOT_SUFFIX = "img"

MACHINE_FIRMWARE_remove = "firmware-imx-epdc"
```

## conf/machine/include/colibri-imx6.inc
```bitbake
IMAGE_CLASSES_append = " image_type_tezi"
IMAGE_FSTYPES_append = " teziimg"
TORADEX_PRODUCT_IDS = "0014 0015 0016 0017"
# The payload offsets are given in number of 512 byte blocks.
OFFSET_BOOTROM_PAYLOAD = "2"
OFFSET_SPL_PAYLOAD = "138"

MACHINE_NAME = "Colibri-iMX6"

IMAGE_BOOT_FILES_append = " boot.scr-${MACHINE};boot.scr"
WKS_FILE_DEPENDS_append = " u-boot-distro-boot"

KERNEL_DEVICETREE += "imx6dl-colibri-iris.dtb imx6dl-colibri-iris-v2.dtb"
PREFERRED_PROVIDER_virtual/kernel = "linux-toradex"
PREFERRED_PROVIDER_virtual/kernel_preempt-rt = "linux-toradex"
PREFERRED_PROVIDER_virtual/kernel_use-mainline-bsp = "linux-toradex-mainline"
PREFERRED_PROVIDER_virtual/kernel_use-mainline-bsp_preempt-rt = "linux-toradex-mainline"
PREFERRED_PROVIDER_virtual/dtb_use-mainline-bsp = "device-tree-overlays-mainline"

PREFERRED_PROVIDER_u-boot-default-script = "u-boot-distro-boot"
UBOOT_SUFFIX = "img"

MACHINE_FIRMWARE_remove = "firmware-imx-epdc"
```

## conf/machine/include/colibri-imx6ull-emmc.inc
```bitbake
IMAGE_CLASSES_append = " image_type_tezi"
IMAGE_FSTYPES_append = " teziimg"
# The payload offsets are given in number of 512 byte blocks.
OFFSET_BOOTROM_PAYLOAD = "2"
TORADEX_PRODUCT_IDS = "0062"
TORADEX_FLASH_TYPE = "emmc"

WIC_CREATE_EXTRA_ARGS_append = " --no-fstab-update"

MACHINE_NAME = "Colibri-iMX6ULL-eMMC"

PREFERRED_PROVIDER_u-boot-default-script = "u-boot-distro-boot"

# MACHINEOVERRIDES_append_upstream = ":use-mainline-bsp"

UBOOT_MAKE_TARGET_colibri-imx6ull-emmc = "u-boot.imx"
UBOOT_ENTRYPOINT_colibri-imx6ull-emmc = "0x81000000"
UBOOT_DTB_LOADADDRESS_colibri-imx6ull-emmc = "0x82100000"
UBOOT_DTBO_LOADADDRESS_colibri-imx6ull-emmc = "0x87000000"

TEZI_EXTERNAL_KERNEL_DEVICETREE_BOOT = "colibri-imx6ull_parallel-rgb_vga_overlay.dtbo colibri-imx6ull_ad7879_overlay.dtbo"
# This config will be enabled when respective overlays will be added to the upstream.
# TEZI_EXTERNAL_KERNEL_DEVICETREE_BOOT_use-mainline-bsp = "colibri-imx6ull_parallel-rgb_vga_overlay.dtbo colibri-imx6ull_ad7879_overlay.dtbo display-vga_overlay.dtbo"

PREFERRED_PROVIDER_virtual/kernel = "linux-toradex"
PREFERRED_PROVIDER_virtual/kernel_preempt-rt = "linux-toradex"
PREFERRED_PROVIDER_virtual/kernel_use-mainline-bsp = "linux-toradex-mainline"
PREFERRED_PROVIDER_virtual/kernel_use-mainline-bsp_preempt-rt = "linux-toradex-mainline"
PREFERRED_PROVIDER_virtual/dtb_use-mainline-bsp = "device-tree-overlays-mainline"
```

## conf/machine/include/colibri-imx6ull.inc
```bitbake
IMAGE_CLASSES += "image_type_tezi"
IMAGE_FSTYPES += "teziimg"
TORADEX_PRODUCT_IDS = "0036 0040 0044 0045"
TORADEX_PRODUCT_IDS[0036] = "imx6ull-colibri-eval-v3.dtb"
TORADEX_PRODUCT_IDS[0040] = "imx6ull-colibri-wifi-eval-v3.dtb"
TORADEX_PRODUCT_IDS[0044] = "imx6ull-colibri-eval-v3.dtb"
TORADEX_PRODUCT_IDS[0045] = "imx6ull-colibri-wifi-eval-v3.dtb"
TORADEX_FLASH_TYPE = "rawnand"

IMAGE_FSTYPES += "wic.gz"
WIC_CREATE_EXTRA_ARGS_append = " --no-fstab-update"

MACHINE_NAME = "Colibri-iMX6ULL"

PREFERRED_PROVIDER_u-boot-default-script = "u-boot-distro-boot"
UBOOT_ENTRYPOINT_colibri-imx6ull = "0x81000000"

MACHINEOVERRIDES_append_upstream = ":use-mainline-bsp"

MACHINE_BOOT_FILES = "boot.scr"
IMAGE_BOOT_FILES_append = " ${MACHINE_BOOT_FILES}"
WKS_FILE_DEPENDS_append = " u-boot-distro-boot"

UBOOT_ENTRYPOINT_colibri-imx6ull = "0x81000000"
UBOOT_MAKE_TARGET_colibri-imx6ull = "u-boot.imx"

KERNEL_DEVICETREE_append_use_nxp_bsp = " \
    imx6ull-colibri-aster.dtb imx6ull-colibri-wifi-aster.dtb \
    imx6ull-colibri-iris.dtb imx6ull-colibri-wifi-iris.dtb \
    imx6ull-colibri-iris-v2.dtb imx6ull-colibri-wifi-iris-v2.dtb \
"
PREFERRED_PROVIDER_virtual/kernel_preempt-rt = "linux-toradex-rt"
PREFERRED_PROVIDER_virtual/kernel_upstream = "linux-toradex-mainline"
PREFERRED_PROVIDER_virtual/kernel_upstream_preempt-rt = "linux-toradex-mainline-rt"
```

## conf/machine/include/colibri-imx7-emmc.inc
```bitbake
IMAGE_CLASSES_append = " image_type_tezi"
IMAGE_FSTYPES_append = " teziimg"
# The payload offsets are given in number of 512 byte blocks.
OFFSET_BOOTROM_PAYLOAD = "2"
TORADEX_PRODUCT_IDS = "0039"
TORADEX_FLASH_TYPE = "emmc"

MACHINE_NAME = "Colibri-iMX7-eMMC"

MACHINEOVERRIDES_append_upstream = ":use-mainline-bsp"

MACHINE_FIRMWARE_remove = "firmware-imx-epdc"
MACHINE_FIRMWARE_remove_use-mainline-bsp = "firmware-imx-vpu-imx6q firmware-imx-vpu-imx6d"

PREFERRED_PROVIDER_virtual/kernel = "linux-toradex"
PREFERRED_PROVIDER_virtual/kernel_preempt-rt = "linux-toradex"
PREFERRED_PROVIDER_virtual/kernel_use-mainline-bsp = "linux-toradex-mainline"
PREFERRED_PROVIDER_virtual/kernel_use-mainline-bsp_preempt-rt = "linux-toradex-mainline"
PREFERRED_PROVIDER_virtual/dtb_use-mainline-bsp = "device-tree-overlays-mainline"

KERNEL_DEVICETREE_append_use-nxp-bsp = " \
    imx7d-colibri-emmc-iris.dtb \
    imx7d-colibri-emmc-iris-v2.dtb \
"
KERNEL_DEVICETREE_append_use-mainline-bsp = " \
    imx7d-colibri-emmc-aster.dtb \
"

PREFERRED_PROVIDER_u-boot-default-script = "u-boot-distro-boot"

TEZI_EXTERNAL_KERNEL_DEVICETREE_BOOT = "colibri-imx7_lcd-vga_overlay.dtbo colibri-imx7_ad7879_overlay.dtbo"
TEZI_EXTERNAL_KERNEL_DEVICETREE_BOOT_use-mainline-bsp = "colibri-imx7_parallel-rgb_overlay.dtbo colibri-imx7_ad7879_overlay.dtbo display-vga_overlay.dtbo"

UBOOT_BINARY_colibri-imx7-emmc = "u-boot.imx"
UBOOT_DTB_LOADADDRESS_colibri-imx7-emmc = "0x82000000"
UBOOT_DTBO_LOADADDRESS_colibri-imx7-emmc = "0x87000000"
UBOOT_ENTRYPOINT_colibri-imx7-emmc = "0x81000000"
UBOOT_MAKE_TARGET = "u-boot.imx"
UBOOT_SUFFIX_${MACHINE} = "imx"
```

## conf/machine/include/colibri-imx7.inc
```bitbake
IMAGE_CLASSES_append = " image_type_tezi"
IMAGE_FSTYPES_append = " teziimg"
TORADEX_PRODUCT_IDS = "0032 0033 0041 0081"
TORADEX_PRODUCT_IDS[0032] = "imx7s-colibri-eval-v3.dtb"
TORADEX_PRODUCT_IDS[0033] = "imx7d-colibri-eval-v3.dtb"
TORADEX_PRODUCT_IDS[0041] = "imx7d-colibri-eval-v3.dtb"
TORADEX_PRODUCT_IDS[0081] = "imx7d-colibri-eval-v3.dtb"
TORADEX_FLASH_TYPE = "rawnand"

MACHINE_NAME = "Colibri-iMX7"

MACHINE_FIRMWARE_remove = "firmware-imx-epdc"
MACHINE_FIRMWARE_remove_use-mainline-bsp = "firmware-imx-vpu-imx6q firmware-imx-vpu-imx6d"

KERNEL_DEVICETREE_append_use-nxp-bsp += " \
    imx7d-colibri-iris.dtb \
    imx7d-colibri-iris-v2.dtb \
    imx7s-colibri-iris.dtb \
    imx7s-colibri-iris-v2.dtb \
"
KERNEL_DEVICETREE_append_use-mainline-bsp = " \
    imx7d-colibri-aster.dtb \
    imx7s-colibri-aster.dtb \
"

PREFERRED_PROVIDER_virtual/kernel = "linux-toradex"
PREFERRED_PROVIDER_virtual/kernel_preempt-rt = "linux-toradex"
PREFERRED_PROVIDER_virtual/kernel_use-mainline-bsp = "linux-toradex-mainline"
PREFERRED_PROVIDER_virtual/kernel_use-mainline-bsp_preempt-rt = "linux-toradex-mainline"
PREFERRED_PROVIDER_virtual/dtb_use-mainline-bsp = "device-tree-overlays-mainline"

PREFERRED_PROVIDER_u-boot-default-script = "u-boot-distro-boot"

UBOOT_MAKE_TARGET_colibri-imx7 = "u-boot.imx"
UBOOT_ENTRYPOINT_colibri-imx7 = "0x81000000"
UBOOT_DTB_LOADADDRESS_colibri-imx7 = "0x82000000"
UBOOT_DTBO_LOADADDRESS_colibri-imx7 = "0x87000000"
```

## conf/machine/include/colibri-vf.inc
```bitbake
#IMAGE_CLASSES_append = " image_type_tezi"
#IMAGE_FSTYPES += "teziimg"
TORADEX_PRODUCT_IDS = "0010 0011 0012 0013"
TORADEX_PRODUCT_IDS[0010] = "vf500-colibri-eval-v3.dts"
TORADEX_PRODUCT_IDS[0011] = "vf610-colibri-eval-v3.dts"
TORADEX_PRODUCT_IDS[0012] = "vf610-colibri-eval-v3.dts"
TORADEX_PRODUCT_IDS[0013] = "vf500-colibri-eval-v3.dts"
TORADEX_FLASH_TYPE = "rawnand"
```
