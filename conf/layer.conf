## conf/machine/toradex-osm-imx93.conf
```bitbake
#@TYPE: Machine
#@NAME: Toradex OSM iMX93
#@SOC: i.MX93
#@DESCRIPTION: Machine configuration for Toradex OSM i.MX93 SoM
#@MAINTAINER: Max Krummenacher <max.krummenacher@toradex.com>

MACHINE_NAME = "OSM-iMX93"

MACHINEOVERRIDES =. "tdx:mx93:"

IMX_DEFAULT_BSP = "nxp"

require conf/machine/include/imx-base.inc
# override imx-base.inc which sets this to cortexa55
DEFAULTTUNE:mx93-generic-bsp = "armv8a-crypto"
require conf/machine/include/arm/armv8-2a/tune-cortexa55.inc

# Don't include kernels in standard images
RRECOMMENDS:${KERNEL_PACKAGE_NAME}-base = ""

KERNEL_DTB_PREFIX = "freescale/"
KERNEL_DEVICETREE = " \
    ${KERNEL_DTB_PREFIX}imx93-toradex-osm-dev.dtb \
"
KERNEL_IMAGETYPE:mx93-generic-bsp = "Image.gz"

UBOOT_CONFIG ??= "sd"
UBOOT_CONFIG[sd] = "toradex-osm-imx93_defconfig,sdcard"
SPL_BINARY = "spl/u-boot-spl.bin"

UBOOT_DTB_LOADADDRESS:mx93-generic-bsp = "0x9c400000"
UBOOT_DTBO_LOADADDRESS:mx93-generic-bsp = "0x9c440000"
UBOOT_ENTRYPOINT:mx93-generic-bsp = "0x94400000"
UBOOT_RD_LOADADDRESS = "0x9c800000"

# Set DDR FIRMWARE
DDR_FIRMWARE_NAME = " \
    lpddr4_dmem_1d_v202201.bin \
    lpddr4_dmem_2d_v202201.bin \
    lpddr4_imem_1d_v202201.bin \
    lpddr4_imem_2d_v202201.bin \
"

ATF_PLATFORM = "imx93"

# Set imx-mkimage boot target
IMXBOOT_TARGETS = "flash_singleboot"
IMX_BOOT_SOC_TARGET = "iMX9"

IMAGE_BOOT_FILES:append = " boot.scr-${MACHINE};boot.scr"
WKS_FILE_DEPENDS:append = " u-boot-default-script"
PREFERRED_PROVIDER_u-boot-default-script = "u-boot-distro-boot"

LOADADDR = ""
UBOOT_SUFFIX = "bin"
UBOOT_MAKE_TARGET = ""
IMX_BOOT_SEEK = "32"

SERIAL_CONSOLES = "115200;ttyLP0"

MACHINE_FEATURES += "wifi bluetooth optee tpm2"

PREFERRED_PROVIDER_virtual/kernel = "linux-toradex"
PREFERRED_PROVIDER_virtual/kernel:preempt-rt = "linux-toradex"

IMX_DEFAULT_BOOTLOADER = "u-boot-toradex"
PREFERRED_VERSION_u-boot-toradex = "2024.04%"

IMAGE_CLASSES:append = " image_type_tezi"
IMAGE_FSTYPES += "teziimg"

UBOOT_BINARY_TEZI_EMMC = "imx-boot"
OFFSET_BOOTROM_PAYLOAD = "0"

TEZI_EXTERNAL_KERNEL_DEVICETREE_BOOT = ""

TORADEX_PRODUCT_IDS = "0219"
```

## conf/machine/toradex-smarc-imx95-a1.conf
```bitbake
#@TYPE: Machine
#@NAME: Toradex SMARC iMX95 A1
#@SOC: i.MX 95
#@DESCRIPTION: Machine configuration for Toradex Toradex SMARC i.MX95 Rev A1
#@MAINTAINER: Max Krummenacher <max.krummenacher@toradex.com>

require toradex-smarc-imx95.conf

IMX_SOC_REV:${MACHINE} = "A0"
MACHINEOVERRIDES =. "toradex-smarc-imx95:"
```

## conf/machine/verdin-imx8mp.conf
```bitbake
#@TYPE: Machine
#@NAME: Toradex Verdin iMX8M Plus
#@SOC: i.MX8MP
#@DESCRIPTION: Machine configuration for Toradex Verdin iMX8M Plus SoM
#@MAINTAINER: Max Krummenacher <max.krummenacher@toradex.com>

MACHINE_NAME = "Verdin-iMX8MP"

MACHINEOVERRIDES =. "mx8:mx8m:mx8mp:"

IMX_DEFAULT_BSP = "nxp"

require conf/machine/include/imx-base.inc
# override imx-base.inc which sets this to cortexa53-crypto
DEFAULTTUNE_mx8mp = "aarch64"
require conf/machine/include/tune-cortexa53.inc

# Don't include kernels in standard images
RDEPENDS_${KERNEL_PACKAGE_NAME}-base = ""

KERNEL_DEVICETREE = " \
    freescale/imx8mp-verdin-nonwifi-dev.dtb \
    freescale/imx8mp-verdin-wifi-dev.dtb \
"
KERNEL_IMAGETYPE_aarch64 = "Image.gz"

UBOOT_CONFIG ??= "sd"
UBOOT_CONFIG[sd] = "verdin-imx8mp_defconfig,sdcard"
SPL_BINARY = "spl/u-boot-spl.bin"

UBOOT_ENTRYPOINT = "0x40280000"
UBOOT_RD_LOADADDRESS = "0x60000000"

# Set u-boot DTB
UBOOT_DTB_NAME = "imx8mp-verdin.dtb"

# Set DDR FIRMWARE
LPDDR_FW_VERSION = "_201904"
DDR_FIRMWARE_NAME = " \
    lpddr4_pmu_train_1d_dmem${LPDDR_FW_VERSION}.bin \
    lpddr4_pmu_train_1d_imem${LPDDR_FW_VERSION}.bin \
    lpddr4_pmu_train_2d_dmem${LPDDR_FW_VERSION}.bin \
    lpddr4_pmu_train_2d_imem${LPDDR_FW_VERSION}.bin \
"

ATF_PLATFORM = "imx8mp"

BOOT_SPACE = "65536"
IMAGE_BOOTLOADER = "imx-boot"

# Set imx-mkimage boot target
IMXBOOT_TARGETS = "flash_evk_emmc_fastboot"
IMX_BOOT_SOC_TARGET = "iMX8MP"

# Temporary until we have TEZI for installation on the eMMC
SOC_DEFAULT_WKS_FILE_verdin-imx8mp ?= "verdin-imx8mp-imx-boot-bootpart.wks.in"
# Add 1GB free space to the wic rootfs partition
IMAGE_ROOTFS_EXTRA_SPACE = "1048576"

IMAGE_BOOT_FILES_append = " boot.scr-${MACHINE};boot.scr"
WKS_FILE_DEPENDS_append = " u-boot-default-script"
PREFERRED_PROVIDER_u-boot-default-script = "u-boot-distro-boot"

LOADADDR = ""
UBOOT_SUFFIX = "bin"
UBOOT_MAKE_TARGET = ""
IMX_BOOT_SEEK = "32"

SERIAL_CONSOLES = "115200;ttymxc2"

MACHINE_FEATURES += "3g bluetooth alsa ext2 pci screen touchscreen usbgadget usbhost vfat wifi"

PREFERRED_PROVIDER_virtual/kernel = "linux-toradex"
PREFERRED_PROVIDER_virtual/kernel_preempt-rt = "linux-toradex"
PREFERRED_PROVIDER_virtual/bootloader = "u-boot-toradex"
# Currently we use the nxp 2020.04 downstream for mx8 as some features are
# not yet available in 2020.07.
PREFERRED_VERSION_u-boot-toradex = "2020.04%"

# handle machine firmware
MACHINE_FIRMWARE_append = " linux-firmware-sd8997"
MACHINE_FIRMWARE_remove = "firmware-sof-imx"

IMAGE_CLASSES_append = " image_type_tezi"
IMAGE_FSTYPES += "teziimg"

UBOOT_BINARY_TEZI_EMMC = "imx-boot"
OFFSET_BOOTROM_PAYLOAD = "0"

TORADEX_PRODUCT_IDS = "0058 0061"
TORADEX_PRODUCT_IDS[0058] = "imx8mp-verdin-wifi-dev.dtb"
TORADEX_PRODUCT_IDS[0061] = "imx8mp-verdin-nonwifi-dev.dtb"
```

## conf/machine/verdin-imx95-a1.conf
```bitbake
#@TYPE: Machine
#@NAME: Toradex Verdin iMX95 A1
#@SOC: i.MX 95
#@DESCRIPTION: Machine configuration for Toradex Verdin i.MX95 Rev A1
#@MAINTAINER: Max Krummenacher <max.krummenacher@toradex.com>

require verdin-imx95.conf

IMX_SOC_REV:${MACHINE} = "A0"
MACHINEOVERRIDES =. "verdin-imx95:"
```
